## board/mb4784w/bcm96855_mb4784w_defconfig
```kconfig
# HG3142F / FiberHome (Broadcom BCM6855x)
# 基于主线 configs/bcm96855_defconfig（v2024.04），增补板级选项。
# 未识别的符号会被 kconfig 忽略，不会导致构建失败。

CONFIG_ARM=y
CONFIG_COUNTER_FREQUENCY=50000000
CONFIG_ARCH_BCMBCA=y
CONFIG_TEXT_BASE=0x01000000
CONFIG_SYS_MALLOC_LEN=0x2000000
CONFIG_SYS_MALLOC_F_LEN=0x8000
CONFIG_BCM6855=y
CONFIG_TARGET_BCM96855=y
CONFIG_NR_DRAM_BANKS=1
CONFIG_HAS_CUSTOM_SYS_INIT_SP_ADDR=y
CONFIG_CUSTOM_SYS_INIT_SP_ADDR=0x2000000
CONFIG_DEFAULT_DEVICE_TREE="bcm96855-mb4784w"
CONFIG_IDENT_STRING=" HG3142F (BCM6855x)"
CONFIG_SYS_LOAD_ADDR=0x01000000
CONFIG_ENV_VARS_UBOOT_CONFIG=y
CONFIG_SYS_BOOTM_LEN=0x4000000
CONFIG_OF_STDOUT_VIA_ALIAS=y
CONFIG_DISPLAY_BOARDINFO_LATE=y
CONFIG_HUSH_PARSER=y
CONFIG_CMD_CACHE=y
CONFIG_OF_EMBED=y
CONFIG_CLK=y

# ---- 板级增补：调试与网络引导 ----
CONFIG_ENV_IS_NOWHERE=y
CONFIG_USE_BOOTCOMMAND=y
CONFIG_BOOTCOMMAND="echo 'HG3142F U-Boot (RAM boot)'; run distro_bootcmd"
CONFIG_CMD_MEMINFO=y
CONFIG_CMD_BOOTMENU=y
CONFIG_CMD_NET=y
CONFIG_CMD_DHCP=y
CONFIG_CMD_PING=y
CONFIG_CMD_TFTPBOOT=y
CONFIG_NET_RANDOM_ETHADDR=y

# ---- NAND（阶段 C 用，先在 RAM 版里关掉以降低风险）----
# CONFIG_NAND=y
# CONFIG_NAND_BRCMNAND=y
# CONFIG_CMD_NAND=y
# CONFIG_MTD=y
```
